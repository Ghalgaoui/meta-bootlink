## conf/layer.conf
```bitbake
# We have a conf and classes directory, add to BBPATH
BBPATH .= ":${LAYERDIR}"

# We have recipes-* directories, add to BBFILES
BBFILES += "${LAYERDIR}/recipes-*/*/*.bb \
            ${LAYERDIR}/recipes-*/*/*.bbappend"

BBFILE_COLLECTIONS += "meta-bootlink"
BBFILE_PATTERN_meta-bootlink = "^${LAYERDIR}/"
BBFILE_PRIORITY_meta-bootlink = "6"

LAYERDEPENDS_meta-bootlink = "core"
LAYERSERIES_COMPAT_meta-bootlink = "dunfell"
```
